## main/Kconfig.projbuild
```kconfig
menu "IoT Gateway Configuration"

# =====================================================================
menu "Device identity"

    comment "Factory defaults - values saved on the web config page take precedence"

    config IOT_DEVICE_ID
        string "Device ID (devId)"
        default "JXGS001"
        help
            设备号。用于上线包 / 心跳包的 devId，以及上位机下发命令之前数据报文的默认 devId。
            每台网关必须唯一。

            这里是默认值。devId、devNumber、上位机端口、本机端口、以太网 MAC 是出厂参数：
            出货时用出厂密码（IOT_FACTORY_PASSWORD）登录配置网页逐台设置，不必为每台单独编译。
            其余参数由客户在配置网页修改。网页中保存过的值优先于这里的值。

    config IOT_DEVICE_NUMBER
        string "Device number (devNumber)"
        default "IIIG_1.0"
        help
            数据报文中的 devNumber 字段。

endmenu

# =====================================================================
menu "Host connection"

    comment "Gateway connects to the host (upper computer)"
    comment "Address and ports: factory defaults, overridden by the web config page"

    choice IOT_HOST_IP_MODE
        prompt "IP version"
        default IOT_HOST_IPV4
        help
            上位机地址的 IP 版本，本机服务端口也使用同一版本。

        config IOT_HOST_IPV4
            bool "IPv4"

        config IOT_HOST_IPV6
            bool "IPv6"

    endchoice

    config IOT_HOST_IPV4_ADDR
        string "Host IPv4 address"
        default "192.168.0.165"
        depends on IOT_HOST_IPV4
        help
            上位机 IPv4 地址。

    config IOT_HOST_IPV6_ADDR
        string "Host IPv6 address"
        default "FE80::30AD:E57B:C212:68AD"
        depends on IOT_HOST_IPV6
        help
            上位机 IPv6 地址。

    config IOT_HOST_REPORT_PORT
        int "Data report port"
        range 0 65535
        default 8761
        help
            上位机接收数据报文的端口（采集数据、开关量、传感器等）。

    config IOT_HOST_LINK_PORT
        int "Online / heartbeat port"
        range 0 65535
        default 8766
        help
            上位机接收上线包和心跳包的端口；该连接上收到的纯数字会被当作时间戳用于校时。

    config IOT_HOST_OTA_PORT
        int "OTA control port"
        range 0 65535
        default 8768
        help
            上位机 OTA 控制通道端口。该连接同样发送上线包和心跳包，
            并接收 "OTA_UPDATE:<url>" 和 "TIMESTAMP:<ms>" 命令。

    config IOT_HEARTBEAT_INTERVAL_MS
        int "Heartbeat interval (ms)"
        range 100 60000
        default 1000
        help
            心跳包发送间隔。

    config IOT_RECONNECT_INTERVAL_MS
        int "Reconnect interval (ms)"
        range 100 60000
        default 5000
        help
            与上位机或网口 PLC 断线后的重连间隔。

endmenu

# =====================================================================
menu "Local server"

    comment "Host connects to the gateway"
    comment "Ports: factory defaults, overridden by the web config page"

    config IOT_CMD_PORT
        int "Command port"
        range 0 65535
        default 8765
        help
            本机监听的命令端口，接收上位机 JSON 命令（StartFlush / EndFlush / PowerOn /
            PowerOff / single / group）。

    config IOT_ADVERTISED_PORT
        int "Port advertised in online packet (connectPort)"
        range 0 65535
        default 8766
        help
            上线包 / 心跳包中 connectPort 字段的值。历史上固定为 8766，
            请确认上位机实际用它连接本机的哪个端口。

    config IOT_FILE_SERVER
        bool "Enable file transfer server"
        default y
        help
            监听文件端口接收上位机分包发送的文件。不需要接收文件的设备可以关闭，
            节省一个任务和一个 socket。

    config IOT_FILE_PORT
        int "File transfer port"
        range 0 65535
        default 8766
        depends on IOT_FILE_SERVER
        help
            本机监听的文件端口。

    config IOT_KEEPALIVE_IDLE
        int "TCP keep-alive idle time (s)"
        default 5
        help
            连接空闲多久后开始发送 keep-alive 探测包。

    config IOT_KEEPALIVE_INTERVAL
        int "TCP keep-alive interval (s)"
        default 5
        help
            keep-alive 探测包的发送间隔。

    config IOT_KEEPALIVE_COUNT
        int "TCP keep-alive retry count"
        default 3
        help
            连续多少次探测无应答后判定连接断开。

endmenu

# =====================================================================
menu "Network"

    comment "Factory defaults - values saved on the web config page take precedence"

    config IOT_WIFI_SSID
        string "Wi-Fi SSID"
        default ""
        help
            要连接的 Wi-Fi 名称。留空表示不使用 Wi-Fi（只用以太网）。
            出厂默认值，现场可在配置网页修改。

    config IOT_WIFI_PASSWORD
        string "Wi-Fi password"
        default ""
        help
            Wi-Fi 密码，开放网络留空。出厂默认值，现场可在配置网页修改。

    config IOT_ETH_W5500
        bool "W5500 Ethernet module"
        default y
        help
            板上的 W5500 SPI 以太网模块。没有焊接以太网模块的板子关闭此项。

    if IOT_ETH_W5500

        config IOT_ETH_SPI_HOST
            int "SPI host"
            range 0 2
            default 1

        config IOT_ETH_SPI_SCLK_GPIO
            int "SPI SCLK GPIO"
            default 15

        config IOT_ETH_SPI_MOSI_GPIO
            int "SPI MOSI GPIO"
            default 6

        config IOT_ETH_SPI_MISO_GPIO
            int "SPI MISO GPIO"
            default 7

        config IOT_ETH_SPI_CS_GPIO
            int "SPI CS GPIO"
            default 16

        config IOT_ETH_SPI_INT_GPIO
            int "Interrupt GPIO"
            default 5

        config IOT_ETH_RST_GPIO
            int "Reset GPIO (-1: not connected)"
            default 4

        config IOT_ETH_SPI_CLOCK_MHZ
            int "SPI clock (MHz)"
            range 5 80
            default 40

        config IOT_ETH_MAC
            string "Ethernet MAC address"
            default ""
            help
                以太网（W5500）使用的 MAC 地址，格式 AA:BB:CC:DD:EE:FF。
                W5500 没有出厂 MAC。留空时由 ESP32 芯片出厂 MAC 自动生成，每台设备都不同，一般不用填写。
                需要按自己的编号规则指定时再填，例如 02:00:00:11:42:03（02 开头是本地管理地址）；
                老设备升级固件时，如果客户现场按 MAC 绑定了 IP 或白名单，需填回原来的 MAC。
                MAC 属于出厂参数：可用出厂密码登录配置网页逐台设置，客户不能修改，恢复出厂也不会改变。

        config IOT_ETH_DHCP
            bool "Obtain IP address automatically (DHCP)"
            default y
            help
                关闭时使用下面的静态地址。出厂默认值，现场可在配置网页修改。

        config IOT_ETH_STATIC_IP
            string "Static IP"
            default "192.168.1.200"
            depends on !IOT_ETH_DHCP

        config IOT_ETH_STATIC_MASK
            string "Subnet mask"
            default "255.255.255.0"
            depends on !IOT_ETH_DHCP

        config IOT_ETH_STATIC_GATEWAY
            string "Gateway"
            default "192.168.1.1"
            depends on !IOT_ETH_DHCP

        config IOT_ETH_STATIC_DNS
            string "DNS server"
            default "192.168.1.1"
            depends on !IOT_ETH_DHCP

    endif # IOT_ETH_W5500

    config IOT_AP_PASSWORD
        string "Config hotspot password"
        default "12345678"
        help
            配置热点 IoTGW-xxxx 的密码，至少 8 位。出厂参数：可用出厂密码在配置网页逐台设置（如印在标签上），客户不能修改。
            热点只在以下情况打开：出厂状态（从未保存过配置）、5 秒内连按 3 次复位键
            （或快速断电上电 3 次）；10 分钟内没有人连接则自动关闭。网络断开不会打开热点。

    config IOT_WEB_PASSWORD
        string "Config web page password"
        default "admin"
        help
            配置网页客户账号 admin 的登录密码。出厂默认值，现场可在配置网页修改。

    config IOT_WEB_AP_ONLY
        bool "Config web page: hotspot access only"
        default n
        help
            打开后配置网页只能通过配置热点（http://192.168.4.1）访问，
            从局域网 IP 访问会被拒绝，避免网页密码在局域网中明文传输。
            出厂默认值，现场可在配置网页"系统"中修改。

    config IOT_FACTORY_PASSWORD
        string "Factory password (config web page)"
        default "iotgw-factory"
        help
            出厂密码：配置网页厂家账号 factory 的密码，用它登录时可修改出厂参数（devId、devNumber、上位机端口、
            本机命令 / 文件端口、以太网 MAC）。所有设备相同，只给生产 / 售后人员，不要告诉客户。
            出厂参数在网页中保存后单独存放，客户恢复出厂不会清除；没在网页中设置过时使用
            menuconfig 中的值。留空表示禁用出厂登录。

endmenu

# =====================================================================
menu "Data acquisition"

    comment "UART1 serves only ONE serial protocol at a time"
    comment "Network protocols can be combined with each other and with one serial protocol"

    config IOT_SERIAL_TIMEOUT_MS
        int "Serial PLC response timeout (ms)"
        range 50 5000
        default 500
        help
            每次串口读请求后等待完整应答的最长时间，超时则跳过该数据点。

    config IOT_TESTER_TIMEOUT_MS
        int "Safety tester response timeout (ms)"
        range 50 5000
        default 1000
        depends on TESTER_76T || TESTER_AINUO
        help
            安规测试仪读取结果、下发组参数时等待应答的最长时间。

    # ------------------------------------------------ Mitsubishi FX
    menuconfig PLC_FX
        bool "Mitsubishi FX PLC"
        default n
        help
            三菱 FX 系列 PLC。串口支持编程口（RS232）和计算机链接（RS485），网口使用 MC 协议。

    if PLC_FX

        choice PLC_FX_CONNECT_MODE
            prompt "Connection"
            default PLC_FX_CONNECT_RS485

            config PLC_FX_CONNECT_RS232
                bool "RS232 (programming port)"
                help
                    编程口只支持读 D 寄存器（16 位）。

            config PLC_FX_CONNECT_RS485
                bool "RS485 (computer link)"

            config PLC_FX_CONNECT_NETWORK
                bool "Ethernet (MC protocol)"
                help
                    MC 协议支持读 D 寄存器（16 / 32 位）和 Y 输出位。

        endchoice

        choice PLC_FX_DEVICE_TYPE
            prompt "Device"
            default PLC_FX_OTHER_DEVICE
            help
                选择现场设备，决定读取哪些寄存器（点表见 plc_points.c）以及上报方式。
                已适配的具体设备目前只有 RS485 点表，其他连接方式只显示 Common。

            config PLC_FX_OTHER_DEVICE
                bool "Common FX device"
                help
                    其他尚未单独适配、使用标准 FX 协议的设备。读取 plc_points.c 中当前连接方式
                    对应的 Common 点表，接入新设备时按现场修改该点表；数据逐点单值上报。
                    （当前 Common 点表中为测试数据）

            config PLC_FX_RY_LINE
                bool "RiYue production line"
                depends on PLC_FX_CONNECT_RS485
                help
                    日跃产线：产量累加值，值变化时才上报。

            config PLC_FX_XF_CONTROLLER
                bool "Crane controller"
                depends on PLC_FX_CONNECT_RS485
                help
                    行车控制器：各车运行时间、工位数值，值变化时才上报。

            config PLC_FX_SN_CACLREFILMAC
                bool "Refrigerant filling machine (ShengNeng workshop 2-4)"
                depends on PLC_FX_CONNECT_RS485
                help
                    生能 2-4 车间冷媒灌注机：10 个数据点收齐后合并为一条批量报文；
                    支持上位机 single 命令设定充注量。

        endchoice

        config PLC_FX_IPV4_ADDR
            string "PLC IPv4 address"
            default "169.254.221.82"
            depends on PLC_FX_CONNECT_NETWORK

        config PLC_FX_TCP_PORT
            int "PLC TCP port"
            range 0 65535
            default 8765
            depends on PLC_FX_CONNECT_NETWORK

    endif # PLC_FX

    # ------------------------------------------------ Omron HostLink
    menuconfig PLC_HOSTLINK
        bool "Omron PLC (HostLink, serial)"
        default n
        help
            欧姆龙 PLC，HostLink（FINS）串口协议。当前串口参数为 115200 8N1。

    if PLC_HOSTLINK

        choice PLC_HOSTLINK_DEVICE_TYPE
            prompt "Device"
            default PLC_HOSTLINK_OTHER_DEVICE

            config PLC_HOSTLINK_OTHER_DEVICE
                bool "Common HostLink device"
                help
                    其他尚未单独适配、使用标准 HostLink 协议的设备。读取 plc_poll.c 中的通用点表，
                    接入新设备时按现场修改该点表；数据逐点单值上报。
                    （当前通用点表中为测试数据）

            config PLC_HOSTLINK_SN_CACLREFILMAC
                bool "Refrigerant filling machine (ShengNeng workshop 1)"
                help
                    生能 1 车间冷媒灌注机：27 个数据点收齐后合并为一条批量报文；
                    支持上位机 single 命令设定 A/B 充注量。

        endchoice

        choice PLC_HOSTLINK_CONNECT_MODE
            prompt "Connection"
            default PLC_HOSTLINK_CONNECT_RS232

            config PLC_HOSTLINK_CONNECT_RS232
                bool "RS232"

            config PLC_HOSTLINK_CONNECT_RS485
                bool "RS485"

        endchoice

    endif # PLC_HOSTLINK

    # ------------------------------------------------ Siemens PPI / S7
    menuconfig PLC_PPI
        bool "Siemens S7-200 PLC (PPI serial / S7 Ethernet)"
        default n
        help
            西门子 S7-200 系列。串口使用 PPI 协议（RS485），网口使用 S7 协议（ISO-on-TCP）。

    if PLC_PPI

        choice PLC_PPI_CONNECT_MODE
            prompt "Connection"
            default PLC_PPI_CONNECT_RS485

            config PLC_PPI_CONNECT_RS485
                bool "RS485 (PPI)"

            config PLC_PPI_CONNECT_NETWORK
                bool "Ethernet (S7)"

        endchoice

        choice PLC_PPI_DEVICE_TYPE
            prompt "Device"
            default PLC_PPI_OTHER_DEVICE
            help
                选择现场设备，决定读取哪些寄存器（点表见 plc_points.c）。
                已适配的具体设备目前只有网口（S7）点表，串口只显示 Common。

            config PLC_PPI_OTHER_DEVICE
                bool "Common PPI / S7 device"
                help
                    其他尚未单独适配、使用标准 PPI（串口）/ S7（网口）协议的设备。读取 plc_points.c 中
                    当前连接方式对应的 Common 点表，接入新设备时按现场修改该点表；数据逐点单值上报。
                    （当前串口 Common 点表中为测试数据，网口 Common 点表为空）

            config PLC_PPI_ELECTROLYSIS_DEVICE
                bool "Electrolysis cabinet"
                depends on PLC_PPI_CONNECT_NETWORK
                help
                    电解炉电解柜：运行 / 故障状态、电压、电流、温度、电解时间等。

            config PLC_PPI_CONTROLLER_DEVICE
                bool "Electrolysis furnace control cabinet"
                depends on PLC_PPI_CONNECT_NETWORK
                help
                    电解炉控制柜：各阀门开关到位、泵输出、冷却水压力等（FR001~022）。
                    同一现场的真空 / 压力数据通过 Modbus TCP 读取（FR023~032）。

        endchoice

        config PLC_PPI_IPV4_ADDR
            string "PLC IPv4 address"
            default "192.168.1.10"
            depends on PLC_PPI_CONNECT_NETWORK

        config PLC_PPI_TCP_PORT
            int "PLC TCP port"
            range 0 65535
            default 102
            depends on PLC_PPI_CONNECT_NETWORK

    endif # PLC_PPI

    # ------------------------------------------------ Modbus
    menuconfig PLC_MODBUS
        bool "Modbus device (RTU serial / TCP)"
        default n
        help
            Modbus 设备。串口为 Modbus RTU（esp-modbus 主站，参数表见 master.c），
            网口为 Modbus TCP（点表见 plc_points.c）。

    if PLC_MODBUS

        choice PLC_MODBUS_CONNECT_MODE
            prompt "Connection"
            default PLC_MODBUS_CONNECT_RS485

            config PLC_MODBUS_CONNECT_RS232
                bool "RS232 (Modbus RTU)"

            config PLC_MODBUS_CONNECT_RS485
                bool "RS485 (Modbus RTU)"

            config PLC_MODBUS_CONNECT_NETWORK
                bool "Ethernet (Modbus TCP)"

        endchoice

        choice PLC_MODBUS_RTU_DEVICE
            prompt "Device"
            default PLC_MODBUS_RTU_RECORDER
            depends on PLC_MODBUS_CONNECT_RS232 || PLC_MODBUS_CONNECT_RS485
            help
                Modbus RTU 设备型号，决定 master.c 中使用的参数表、串口参数和上报方式。

            config PLC_MODBUS_RTU_RECORDER
                bool "Paperless recorder"
                help
                    无纸记录仪（9600 8N1）：读取 6 个温区温度（浮点），上报为 FR001~006。

            config PLC_MODBUS_RTU_TEMP_CONTROLLER
                bool "Temperature controller"
                help
                    电镀厂温控仪表（9600 8N2）：读取测量值、设定值、小数点位置，上报测量温度。

            config PLC_MODBUS_RTU_RECTIFIER
                bool "Rectifier"
                help
                    电镀厂整流机（19200 8E1）：读取电压、电流，分别上报为 FR001、FR002。

            config PLC_MODBUS_RTU_FREEZER
                bool "Freezer"
                help
                    电镀厂冷冻机（4800 8N1）：读取温度，上报为 FR001。

            config PLC_MODBUS_RTU_AIR_SWITCH
                bool "Air switch"
                help
                    智能空开（9600 8N1）：响应上位机 PowerOn / PowerOff 命令合闸 / 分闸。

        endchoice

        choice PLC_MODBUS_TCP_DEVICE
            prompt "Device"
            default PLC_MODBUS_TCP_FURNACE_VACUUM
            depends on PLC_MODBUS_CONNECT_NETWORK
            help
                Modbus TCP 设备，决定读取哪些寄存器（点表见 plc_points.c）。

            config PLC_MODBUS_TCP_OTHER_DEVICE
                bool "Common Modbus TCP device"
                help
                    其他尚未单独适配、使用标准 Modbus TCP 的设备。读取 plc_points.c 中的 Common 点表
                    （当前为空），接入新设备时按现场填写；数据逐点单值上报。

            config PLC_MODBUS_TCP_FURNACE_VACUUM
                bool "Electrolysis furnace vacuum / pressure"
                help
                    电解炉 11# / 12# 炉真空度、压力、炉体水温（FR023~032），
                    与 S7 电解炉控制柜（FR001~022）同一现场配合使用。

        endchoice

        config PLC_MODBUS_IPV4_ADDR
            string "Device IPv4 address"
            default "192.168.2.192"
            depends on PLC_MODBUS_CONNECT_NETWORK

        config PLC_MODBUS_TCP_PORT
            int "Device TCP port"
            range 0 65535
            default 502
            depends on PLC_MODBUS_CONNECT_NETWORK

    endif # PLC_MODBUS

    # ------------------------------------------------ LS / DBS
    menuconfig PLC_LS_LOAD
        bool "LS / DBS device (RS232)"
        default n
        help
            DBS 串口设备（RS232，9600 8N1），按地址读取 4 位 ASCII 数据。

    if PLC_LS_LOAD

        config PLC_LS_LOAD_CONNECT_RS232
            bool
            default y

    endif # PLC_LS_LOAD

    # ------------------------------------------------ Safety testers
    menuconfig TESTER_76T
        bool "Safety tester 76T (serial)"
        default n
        help
            76T 安规综合测试仪（9600 8N1）。读取当前组 / 历史组测试结果，
            支持上位机 group 命令下发组参数。

    if TESTER_76T

        choice TESTER_76T_CONNECT_MODE
            prompt "Connection"
            default TESTER_76T_CONNECT_RS232

            config TESTER_76T_CONNECT_RS232
                bool "RS232"

            config TESTER_76T_CONNECT_RS485
                bool "RS485"

        endchoice

    endif # TESTER_76T

    menuconfig TESTER_AINUO
        bool "Safety tester Ainuo (serial)"
        default n
        help
            艾诺安规综合测试仪（ASCII 协议，19200 8N1）。读取当前组测试结果，
            支持上位机 group 命令下发组参数。

    if TESTER_AINUO

        choice TESTER_AINUO_CONNECT_MODE
            prompt "Connection"
            default TESTER_AINUO_CONNECT_RS232

            config TESTER_AINUO_CONNECT_RS232
                bool "RS232"

            config TESTER_AINUO_CONNECT_RS485
                bool "RS485"

        endchoice

    endif # TESTER_AINUO

    # ------------------------------------------------ 自动推导（不在菜单中显示）
    config APP_USE_RS232
        bool
        default y if PLC_FX_CONNECT_RS232 || PLC_HOSTLINK_CONNECT_RS232 || PLC_LS_LOAD || \
                     PLC_MODBUS_CONNECT_RS232 || TESTER_76T_CONNECT_RS232 || TESTER_AINUO_CONNECT_RS232

    config APP_USE_RS485
        bool
        default y if PLC_FX_CONNECT_RS485 || PLC_HOSTLINK_CONNECT_RS485 || PLC_PPI_CONNECT_RS485 || \
                     PLC_MODBUS_CONNECT_RS485 || TESTER_76T_CONNECT_RS485 || TESTER_AINUO_CONNECT_RS485

endmenu

# =====================================================================
menu "Sensors"

    config SENSOR_MAX6675
        bool "MAX6675 thermocouple"
        default n
        help
            MAX6675 K 型热电偶测温，每 250ms 读取一次，滤波后上报。

    if SENSOR_MAX6675

        config MAX6675_CS_GPIO
            int "CS GPIO"
            default 10
            range 0 48
            help
                MAX6675 片选（低电平有效）。

        config MAX6675_SCK_GPIO
            int "SCK GPIO"
            default 12
            range 0 48
            help
                MAX6675 时钟。

        config MAX6675_SO_GPIO
            int "SO (MISO) GPIO"
            default 13
            range 0 48
            help
                MAX6675 数据输出。

    endif # SENSOR_MAX6675

endmenu

# =====================================================================
menu "Debug"

    config IOT_DEBUG_STACK_MONITOR
        bool "Print task stack high water marks"
        default n
        help
            周期打印各应用任务历史最小剩余栈（字节）和剩余堆内存，用于调整栈大小。

    config IOT_DEBUG_STACK_MONITOR_INTERVAL_S
        int "Stack monitor interval (s)"
        range 5 3600
        default 30
        depends on IOT_DEBUG_STACK_MONITOR

endmenu

endmenu # IoT Gateway Configuration
```
